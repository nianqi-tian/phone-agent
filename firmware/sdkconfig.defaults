## firmware/sdkconfig.defaults
```kconfig
CONFIG_BT_ENABLED=y
CONFIG_BT_BLUEDROID_ENABLED=n
CONFIG_BT_NIMBLE_ENABLED=y
CONFIG_BT_NIMBLE_MAX_CONNECTIONS=2
CONFIG_BT_NIMBLE_MAX_BONDS=3
CONFIG_BT_NIMBLE_MAX_CCCDS=8
CONFIG_BT_NIMBLE_NVS_PERSIST=y
CONFIG_BT_NIMBLE_SECURITY_ENABLE=y
CONFIG_BT_NIMBLE_ROLE_CENTRAL=n
CONFIG_BT_NIMBLE_ROLE_OBSERVER=n
CONFIG_BT_NIMBLE_ATT_PREFERRED_MTU=64
CONFIG_ESPTOOLPY_FLASHSIZE_4MB=y
CONFIG_FREERTOS_HZ=1000
CONFIG_IDF_TARGET="esp32s3"
CONFIG_AGENTMOUSE_STATUS_RGB=y
CONFIG_AGENTMOUSE_RGB_GPIO=48
CONFIG_AGENTMOUSE_RGB_BRIGHTNESS=48
```

## firmware/sdkconfig.defaults.esp32s3
```kconfig
CONFIG_IDF_TARGET="esp32s3"
CONFIG_AGENTMOUSE_STATUS_RGB=y
CONFIG_AGENTMOUSE_RGB_GPIO=48
CONFIG_AGENTMOUSE_RGB_BRIGHTNESS=48
```
